## Yocto/conf/bblayers.conf
```bitbake
# POKY_BBLAYERS_CONF_VERSION is increased each time build/conf/bblayers.conf
# changes incompatibly
POKY_BBLAYERS_CONF_VERSION = "2"

BBPATH = "${TOPDIR}"
BBFILES ?= ""

BBLAYERS ?= " \
  /home/taqi/yocto_project/poky/meta \
  /home/taqi/yocto_project/poky/meta-poky \
  /home/taqi/yocto_project/poky/meta-yocto-bsp \
  /home/taqi/yocto_project/meta-openembedded/meta-oe \
  /home/taqi/yocto_project/meta-openembedded/meta-python \
  /home/taqi/yocto_project/meta-openembedded/meta-networking \
  /home/taqi/yocto_project/meta-openembedded/meta-multimedia \
  /home/taqi/yocto_project/meta-raspberrypi \
  /home/taqi/yocto_project/meta-infotainment \
  /home/taqi/yocto_project/meta-qt6 \
  "
```
